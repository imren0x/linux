## Documentation/devicetree/bindings/mfd/siliconmitus,sm5703.yaml
```yaml
# SPDX-License-Identifier: (GPL-2.0-only OR BSD-2-Clause)
%YAML 1.2
---
$id: http://devicetree.org/schemas/mfd/siliconmitus,sm5703.yaml#
$schema: http://devicetree.org/meta-schemas/core.yaml#

title: Silicon Mitus SM5703 Power Management IC

maintainers:
  - Yumi Yukimura <me.cafebabe@gmail.com>

description:
  The SM5703 is a multifunction device which includes a battery charger,
  USB LDOs, LDOs, a buck converter and a flash LED driver. It is interfaced to
  the host controller using I2C. The fuel gauge is a separate I2C device, see
  siliconmitus,sm5703-fuel-gauge.yaml.

properties:
  compatible:
    const: siliconmitus,sm5703

  reg:
    maxItems: 1

  interrupts:
    maxItems: 1

  mrstb-gpios:
    maxItems: 1
    description:
      GPIO connected to the MRSTB pin. It is driven high to indicate that the
      system is alive (and no reset should be performed).

  regulators:
    $ref: /schemas/regulator/siliconmitus,sm5703-regulator.yaml#

  charger:
    type: object
    $ref: /schemas/power/supply/power-supply.yaml#
    unevaluatedProperties: false

    properties:
      compatible:
        const: siliconmitus,sm5703-charger

      monitored-battery:
        description:
          Phandle to the monitored battery. The battery node needs to contain
          constant-charge-current-max-microamp, constant-charge-voltage-max-microvolt
          and optionally charge-term-current-microamp.

      enable-gpios:
        maxItems: 1
        description:
          GPIO connected to the nCHGEN pin. The GPIO is active-low in hardware.

      extcon:
        maxItems: 1
        description:
          Phandle to the extcon device that reports the connected cable type.
          It is used to select the input current limit.

      siliconmitus,usb-input-current-microamp:
        description: Input current limit for standard USB ports
        default: 500000

      siliconmitus,dcp-input-current-microamp:
        description: Input current limit for dedicated chargers
        default: 1000000

    required:
      - compatible
      - monitored-battery

required:
  - compatible
  - reg
  - interrupts

additionalProperties: false

examples:
  - |
    #include <dt-bindings/gpio/gpio.h>
    #include <dt-bindings/interrupt-controller/irq.h>

    battery: battery {
        compatible = "simple-battery";
        constant-charge-current-max-microamp = <1500000>;
        constant-charge-voltage-max-microvolt = <4330000>;
        charge-term-current-microamp = <200000>;
    };

    i2c {
        #address-cells = <1>;
        #size-cells = <0>;

        pmic@49 {
            compatible = "siliconmitus,sm5703";
            reg = <0x49>;
            interrupt-parent = <&tlmm>;
            interrupts = <62 IRQ_TYPE_EDGE_FALLING>;
            mrstb-gpios = <&tlmm 24 GPIO_ACTIVE_HIGH>;

            regulators {
                ldo3 {
                    regulator-min-microvolt = <3000000>;
                    regulator-max-microvolt = <3000000>;
                };
            };

            charger {
                compatible = "siliconmitus,sm5703-charger";
                monitored-battery = <&battery>;
                enable-gpios = <&tlmm 51 GPIO_ACTIVE_LOW>;
            };
        };
    };
```

## Documentation/devicetree/bindings/power/supply/siliconmitus,sm5703-fuel-gauge.yaml
```yaml
# SPDX-License-Identifier: (GPL-2.0-only OR BSD-2-Clause)
%YAML 1.2
---
$id: http://devicetree.org/schemas/power/supply/siliconmitus,sm5703-fuel-gauge.yaml#
$schema: http://devicetree.org/meta-schemas/core.yaml#

title: Silicon Mitus SM5703 Fuel Gauge

maintainers:
  - Yumi Yukimura <me.cafebabe@gmail.com>

description:
  The fuel gauge of the SM5703 PMIC is a voltage tracking gauge on a separate
  I2C address. It needs battery specific tables and tuning parameters that are
  provided by the battery vendor.

allOf:
  - $ref: power-supply.yaml#

properties:
  compatible:
    const: siliconmitus,sm5703-fuel-gauge

  reg:
    maxItems: 1

  interrupts:
    maxItems: 1

  monitored-battery:
    description: Phandle to the monitored battery

  power-supplies:
    maxItems: 1
    description: Phandle to the charger of the PMIC

  siliconmitus,discharge-table:
    $ref: /schemas/types.yaml#/definitions/uint32-array
    minItems: 16
    maxItems: 16
    description: Battery voltage table for discharging

  siliconmitus,charge-table:
    $ref: /schemas/types.yaml#/definitions/uint32-array
    minItems: 16
    maxItems: 16
    description: Battery voltage table for charging

  siliconmitus,q-table:
    $ref: /schemas/types.yaml#/definitions/uint32-array
    minItems: 16
    maxItems: 16
    description: Battery capacity table

  siliconmitus,rce:
    $ref: /schemas/types.yaml#/definitions/uint32-array
    minItems: 3
    maxItems: 3

  siliconmitus,rs:
    $ref: /schemas/types.yaml#/definitions/uint32-array
    minItems: 4
    maxItems: 4
    description: RS, RS mix factor, RS max, RS min

  siliconmitus,mix:
    $ref: /schemas/types.yaml#/definitions/uint32-array
    minItems: 2
    maxItems: 2
    description: Mix rate and mix init blank

  siliconmitus,topoff-soc:
    $ref: /schemas/types.yaml#/definitions/uint32-array
    minItems: 2
    maxItems: 2
    description: Enable flag and state of charge threshold for top-off

  siliconmitus,dtcd:
    $ref: /schemas/types.yaml#/definitions/uint32

  siliconmitus,vit-period:
    $ref: /schemas/types.yaml#/definitions/uint32

  siliconmitus,volt-cal:
    $ref: /schemas/types.yaml#/definitions/uint32

  siliconmitus,curr-cal:
    $ref: /schemas/types.yaml#/definitions/uint32

  siliconmitus,temp-std:
    $ref: /schemas/types.yaml#/definitions/uint32
    default: 25

  siliconmitus,temp-offset:
    $ref: /schemas/types.yaml#/definitions/uint32
    default: 10

  siliconmitus,temp-offset-cal:
    $ref: /schemas/types.yaml#/definitions/int32

  siliconmitus,charge-offset-cal:
    $ref: /schemas/types.yaml#/definitions/int32

  siliconmitus,temp-poff:
    $ref: /schemas/types.yaml#/definitions/uint32-array
    minItems: 4
    maxItems: 4
    description:
      Voltage threshold and hysteresis (in mV) for the power-off protection
      at normal and at low temperature

  siliconmitus,ext-temp-cal:
    $ref: /schemas/types.yaml#/definitions/uint32-array
    minItems: 8
    maxItems: 8
    description:
      High temperature enable, denominator, charging factor and discharging
      factor, followed by the same values for low temperature

  siliconmitus,min-charge-current-milliamp:
    default: 100

required:
  - compatible
  - reg
  - monitored-battery
  - siliconmitus,discharge-table
  - siliconmitus,charge-table
  - siliconmitus,q-table
  - siliconmitus,rce
  - siliconmitus,rs
  - siliconmitus,mix
  - siliconmitus,topoff-soc
  - siliconmitus,dtcd
  - siliconmitus,vit-period
  - siliconmitus,volt-cal
  - siliconmitus,curr-cal

unevaluatedProperties: false

examples:
  - |
    i2c {
        #address-cells = <1>;
        #size-cells = <0>;

        fuel-gauge@71 {
            compatible = "siliconmitus,sm5703-fuel-gauge";
            reg = <0x71>;
            monitored-battery = <&battery>;

            siliconmitus,discharge-table = <0x1400 0x1b67 0x1cdd 0x1d6f
                                            0x1d8b 0x1de2 0x1e32 0x1e63
                                            0x1eab 0x1edf 0x1f06 0x1f54
                                            0x1fc5 0x20a0 0x2261 0x2399>;
            siliconmitus,charge-table = <0x1400 0x1b67 0x1cdd 0x1d6f
                                         0x1d8b 0x1de2 0x1e32 0x1e63
                                         0x1eab 0x1edf 0x1f06 0x1f54
                                         0x1fc5 0x20a0 0x2261 0x2399>;
            siliconmitus,q-table = <0x00 0x35 0xbf 0x144
                                    0x2d9 0x3e9 0x602 0x821
                                    0xa3b 0xb4b 0xbd5 0xc5a
                                    0xdef 0x1093 0x14cc 0x14dc>;
            siliconmitus,rce = <0x0749 0x0580 0x371>;
            siliconmitus,rs = <0x1ae 0x47a 0x3800 0x00a4>;
            siliconmitus,mix = <0x0503 0x0004>;
            siliconmitus,topoff-soc = <0x0 0x5>;
            siliconmitus,dtcd = <0x1>;
            siliconmitus,vit-period = <0x350a>;
            siliconmitus,volt-cal = <0x809e>;
            siliconmitus,curr-cal = <0x7185>;
        };
    };
```

## Documentation/devicetree/bindings/regulator/ti,lm3632.yaml
```yaml
# SPDX-License-Identifier: (GPL-2.0-only OR BSD-2-Clause)
%YAML 1.2
---
$id: http://devicetree.org/schemas/regulator/ti,lm3632.yaml#
$schema: http://devicetree.org/meta-schemas/core.yaml#

title: TI LM3632 LCD bias and backlight boost power supply

maintainers:
  - Yumi Yukimura <me.cafebabe@gmail.com>

description:
  The TI LM3632 provides LCD bias supplies and a backlight boost converter.
  On some devices the brightness is controlled by the display panel via a PWM
  signal, so the chip only needs to be powered up and configured.

allOf:
  - $ref: regulator.yaml#

properties:
  compatible:
    const: ti,lm3632

  reg:
    maxItems: 1

  enable-gpios:
    maxItems: 1
    description: GPIO connected to the EN (backlight enable) pin

  enp-gpios:
    maxItems: 1
    description: GPIO connected to the ENP (positive LCD bias enable) pin

  enn-gpios:
    maxItems: 1
    description: GPIO connected to the ENN (negative LCD bias enable) pin

  ti,init-sequence:
    $ref: /schemas/types.yaml#/definitions/uint8-array
    description:
      Pairs of register address and value that are written after the chip
      is enabled.

required:
  - compatible
  - reg
  - enable-gpios
  - enp-gpios
  - enn-gpios

unevaluatedProperties: false

examples:
  - |
    #include <dt-bindings/gpio/gpio.h>

    i2c {
        #address-cells = <1>;
        #size-cells = <0>;

        regulator@11 {
            compatible = "ti,lm3632";
            reg = <0x11>;
            enable-gpios = <&tlmm 98 GPIO_ACTIVE_HIGH>;
            enp-gpios = <&tlmm 97 GPIO_ACTIVE_HIGH>;
            enn-gpios = <&tlmm 120 GPIO_ACTIVE_HIGH>;
            ti,init-sequence = /bits/ 8 <0x09 0x41 0x02 0x50 0x03 0x0d>;
        };
    };
```

## drivers/input/fingerprint/Kconfig
```kconfig
# SPDX-License-Identifier: GPL-2.0-only
#
# Fingerprint sensor drivers
#
menuconfig INPUT_FINGERPRINT
	bool "Fingerprint sensors"
	help
	  Say Y here to get to see options for fingerprint sensor drivers.
	  These only provide GPIO, interrupt and key event plumbing for vendor
	  fingerprint HALs; the sensors themselves are driven by TrustZone.

if INPUT_FINGERPRINT

source "drivers/input/fingerprint/goodix/Kconfig"

endif
```

## drivers/input/fingerprint/goodix/Kconfig
```kconfig
config FINGERPRINT_GOODIX_GF3208
	tristate "Goodix GF3208 fingerprint driver support"
	depends on GPIOLIB && OF && NET
	depends on DRM || !DRM
	help
	  Say Y here to enable support for the Goodix GF3208 fingerprint
	  sensor as found on Xiaomi MSM8953 devices. It provides
	  /dev/goodix_fp and a netlink socket for the vendor fingerprint HAL,
	  which talks to the sensor through TrustZone.

	  To compile this driver as a module, choose M here: the module will
	  be called goodix_fp.
```
